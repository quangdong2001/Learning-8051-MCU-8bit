#include <regx52.h>

sbit SHCP = P2^0;
sbit DS = P2^1;
sbit STCP = P2^3;

// Ham gui du lieu tu vi dieu khien ra cho 74HC595

void Send_Data(unsigned char _data)
{
	unsigned char i;
	for(i = 0; i < 8; i++)
	{
		DS = _data & (0x80 >> i);
		SHCP = 0;
		SHCP = 1;
	}
	STCP = 0;
	STCP = 1;
}

unsigned char code Cot[] = {0x01, 0x02, 0x04, 0x08, 0x10, 0x20, 0x40, 0x80};
	
unsigned char code Text[26][8] = {
                              0xFF, 0xC0, 0x80, 0xB7, 0xB7, 0x80, 0xC0, 0xFF,     // A
															0xFF, 0x80, 0x80, 0xB6, 0xB6, 0x80, 0xC9, 0xFF,     // B 
															0xFF, 0xC1, 0x80, 0xBE, 0xBE, 0x9C, 0xDD, 0xFF,     // C
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															0xFF, 0xBC, 0xB8, 0xB2, 0xA6, 0x8E, 0x9E, 0xFF,     // Z
                              };
	
unsigned char code Number[10][8] = {
	                            0xFF, 0xC1, 0x80, 0xAE, 0xB6, 0x80, 0xC1, 0xFF,     // 0
	                            0xFF, 0xFE, 0xEE, 0x80, 0x80, 0xFE, 0xFE, 0xFF,     // 1
															0xFF, 0xDC, 0x98, 0xBA, 0xB6, 0x86, 0xCE, 0xFF,     // 2
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															0xFF, 0xCD, 0x84, 0xB6, 0xB6, 0x80, 0xC1, 0xFF,     // 9
                                   };
	 
// Dung chuong trinh trong ? milisecond
void Sleep_ms(unsigned int t)
{
	unsigned int i, j;
	for(i = 0; i < t; i++)
	{
		for(j = 0; j <123; j++);
	}
}

// Cau hinh cho truyen thong noi tiep 

void Uart_Init()
{
	// Chon timer1 che do 8bit tu nap lai 
	TMOD &= 0x0F;
	TMOD |= 0x20;
	
	// Chon che do truyen not tiep 8bit toc do baud duoc cai boi timer1 
	SM0 = 0;
	SM1 = 1;
	
	// Chon che do nhan di lieu 
	REN = 1;
	
	// Nap thanh ghi TH de cai dat toc do Baud
	TH1 = 0xFD;
	
	// Khoi dong timer1;
	TR1 = 1;
	
	// Gan TI = 1 de thong bao san sang truyen du lieu di
	TI = 1;
	
}

// Ham gui du lieu tu vi dieu khien ra cho thiet bi ngoai 

void Uart_Write(unsigned char _data)
{
	while(TI == 0);
	TI = 0;
	SBUF = _data;
}

// Ham gui chuoi ki tu
void Uart_Write_Text(unsigned char *p)
{
	unsigned char i = 0;
	while(p[i] != 0)
	{
		Uart_Write(p[i]);
		i++;
	}
}

// Ham kiem tra xem co du lieu duoc gui tu ngoai vao trong vi dieu khien khong 
unsigned char Uart_Ready()
{
	return RI;
}

// Ham lay du lieu tu ben ngoai vao cho vi dieu khien 
unsigned char Uart_Read()
{
	RI = 0;
	return SBUF;
}

void Uart_Read_Matrix()
{
	while(1)
	{
		unsigned char i, _data;
		if(Uart_Ready())
		{
			_data = Uart_Read();
			if((_data >= 48) && (_data <= 57))
			{
				while(Uart_Ready() == 0)
				{
					for(i = 0; i < 8; i++)
					{
						Send_Data(Number[_data - 48][i]);
						P0 = Cot[i];
						Sleep_ms(1);
						P0 = 0x00;
					}
				}
			}
			else if((_data >= 65) && (_data <= 90))
			{
				while(Uart_Ready() == 0)
				{
					for(i = 0; i < 8; i++)
					{
						Send_Data(Text[_data - 65][i]);
						P0 = Cot[i];
						Sleep_ms(1);
						P0 = 0x00;
					}
				}
			}
			else if((_data >= 97) &&(_data <= 122))
			{
				while(Uart_Ready() == 0)
				{
					for(i = 0; i < 8; i++)
					{
						Send_Data(Text[_data - 97][i]);
						P0 = Cot[i];
						Sleep_ms(1);
						P0 = 0x00;
					}
				}
			}
		}
	}
}


void main()
{
	Uart_Init();
	Uart_Read_Matrix();
	
}
























