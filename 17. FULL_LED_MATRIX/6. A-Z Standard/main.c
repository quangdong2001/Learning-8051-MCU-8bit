#include <regx52.h>

sbit SH_CP = P3^0;
sbit DS = P3^1;
sbit ST_CP = P3^3;

unsigned char code Cot[] = {0x01, 0x02, 0x04, 0x08, 0x10, 0x20, 0x40, 0x80};

unsigned char code DATA[] = { 
															0xFF, 0xFF, 0xFF, 0xFF, 0xFF, 0xFF, 0xFF, 0xFF,     // Space 
															0xFF, 0xFF, 0xFF, 0xFF, 0xFF, 0xFF, 0xFF, 0xFF,     // Space 
	                            0xFF, 0xFF, 0xFF, 0xFF, 0xFF, 0xFF, 0xFF, 0xFF,     // Space 
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	                            0xFF, 0xFF, 0xFF, 0xFF, 0xFF, 0xFF, 0xFF, 0xFF,     // Space 
   													 };

														 
void Sleep_ms(unsigned int t)
{
	unsigned int i,j;
	for(i = 0 ;i < t; i++)
	{
		for(j = 0; j < 123; j++);
	}
}	

void SEND_DATA(unsigned char a)
{
	unsigned int i;
	for(i = 0; i < 8; i++)
	{
		DS = a & (0x80 >> i);
		
		SH_CP = 0;
		SH_CP = 1;
	}
	ST_CP = 0;
	ST_CP = 1;
}

void AnlphaB()
{
	while(1)
	{
		unsigned int i,j,k;
		for(i = 0; i < 368; i++)
		{
			for(k = 0; k < 2; k++)
			{
				for(j = 0; j < 8; j++)
				{
					SEND_DATA(DATA[i+j+0]);
					SEND_DATA(DATA[i+j+8]);
					SEND_DATA(DATA[i+j+16]);
					SEND_DATA(DATA[i+j+24]);
					SEND_DATA(DATA[i+j+32]);
					SEND_DATA(DATA[i+j+40]);
					
					P0 = Cot[j];
					Sleep_ms(1);
					P0 = 0x00;
					
				}
			}
		}
	}
}
														 
														 
														 
void main()
{
	AnlphaB();
}	
														 
														 
														 
														 
														 
														 
														 
														 
														 
														 