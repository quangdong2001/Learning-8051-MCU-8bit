#include <regx52.h>

unsigned char code Cot[]= { 0x01, 0x02, 0x04, 0x08, 0x10, 0x20, 0x40, 0x80 };

unsigned char code Data[] = {
														  0xFF, 0xFF, 0xFF, 0xFF, 0xFF, 0xFF, 0xFF, 0xFF,     // Space 
															0xFF, 0xFF, 0xFF, 0xFF, 0xFF, 0xFF, 0xFF, 0xFF,     // Space 
															0xFF, 0xFF, 0xFF, 0xFF, 0xFF, 0xFF, 0xFF, 0xFF,     // Space 
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															0xFF, 0xFF, 0xFF, 0xFF, 0xFF, 0xFF, 0xFF, 0xFF,     // Space 
														};
sbit SH_CP = P2^0;
sbit DS = P2^1;
sbit ST_CP = P2^3;
														
#define Port P0 					
														
void Sleep_ms(unsigned int t)
{
	unsigned char i, j;
	for(i = 0; i < t; i++)
	{
		for(j = 0; j < 123; j++);
	}
}


void Send_Data(unsigned char _data)
{
	unsigned char i;
	for(i = 0;i < 8; i++)
	{
		DS = _data & (0x80 >> i);
		SH_CP = 0;
		SH_CP = 1;
	}
	ST_CP = 0;
	ST_CP = 1;
}


void main()
{
	unsigned char i, j, k;
	while(1)
	{
		for(i = 0; i < 200; i++)
		{
			for(k = 0; k < 5; k++)
			{
				for(j = 0; j < 8; j++)
				{
					Send_Data(Data[i+j]);
					Send_Data(Data[i+j+8]);
					Port = Cot[j];
					Sleep_ms(1);
					Port = 0x00;
				}
			}
		}
	}
}








































