#include <regx52.h>

sbit SH_CP = P2^0;
sbit DS = P2^1;
sbit ST_CP = P2^3;


unsigned char code Cot[] = { 0x01, 0x02, 0x04, 0x08, 0x10, 0x20, 0x40, 0x80 };
unsigned char code Data[] = { 
															0xFF, 0xFF, 0xFF, 0xFF, 0xFF, 0xFF, 0xFF, 0xFF,
															0xFF, 0xFF, 0xFF, 0xFF, 0xFF, 0xFF, 0xFF, 0xFF,
															0xFF, 0xFF, 0xFF, 0xFF, 0xFF, 0xFF, 0xFF, 0xFF,
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															0xFF, 0xFF, 0xFF, 0xFF, 0xFF, 0xFF, 0xFF, 0xFF,
														};

														
void Sleep_ms(unsigned int t)
{
	unsigned int i,j;
	for(i = 0; i < t; i++)
	{
		for(j = 0; j < 123; j++);
	}
}


void SEND_DATA(unsigned char a)
{
	unsigned char i;
	for(i = 0; i < 8; i++)
	{
		DS = a & (0x80 >> i);
		
		SH_CP = 0;
		SH_CP = 1;
	}
	ST_CP = 0;
	ST_CP = 1;
}


void HAPPY_NEW_YEAR()
{
	while(1)
	{
		unsigned int i,j,k;
		for(i = 0; i < 160; i++)
		{
			for(k = 0; k < 3; k++)
			{
				for(j = 0; j < 8; j++)
				{
					SEND_DATA(Data[i+j+0]);
					SEND_DATA(Data[i+j+8]);
					SEND_DATA(Data[i+j+16]);
					SEND_DATA(Data[i+j+24]);
					SEND_DATA(Data[i+j+32]);
					SEND_DATA(Data[i+j+40]);
					SEND_DATA(Data[i+j+48]);
					SEND_DATA(Data[i+j+56]);
					
					
					P0 = Cot[j];
					Sleep_ms(1);
					P0 = 0x00;
				}
			}
		}
	}
}


void main()
{
	HAPPY_NEW_YEAR();
}































